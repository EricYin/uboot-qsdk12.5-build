## u-boot-2016/board/ipq6018/Kconfig
```kconfig
if ARCH_IPQ6018

config SYS_CPU
       default "ipq6018"

config SYS_BOARD
       default "ipq6018"

config SYS_VENDOR
       default "qca/arm"

config SYS_CONFIG_NAME
       default "ipq6018"

config USB_XHCI_IPQ
	bool "Enable usb support for ipq6018"

config PCI_IPQ
	bool "Enable pci support for ipq6018"

config IPQ6018_QCA_AQUANTIA_PHY
	bool "Enable Aquantia PHY support for ipq6018"

config BOARD_TYPES
	bool "Support board_type member in global data"
	default y

config LIST_OF_CONFIG_NAMES_SUPPORT
	bool "List of config names support"

config LIST_FUSE
	bool "Enable fuse list command"
	default n

config TARGET_IPQ6018_CMIOT_AX18
    bool "CMIOT AX18 board support"
	default n
    help
      Enable support for CMIOT AX18 board

config TARGET_IPQ6018_GLINET_GL_AX1800
    bool "GLiNet AX1800 board support"
	default n
    help
      Enable support for GLiNet AX1800 board

config TARGET_IPQ6018_JDCLOUD_RE_CS_02
    bool "JDCloud AX6600 (Athena) board support"
	default n
    help
      Enable support for JDCloud AX6600 (Athena) board

config TARGET_IPQ6018_JDCLOUD_RE_CS_07
    bool "JDCloud ER1 board support"
	default n
    help
      Enable support for JDCloud ER1 board

config TARGET_IPQ6018_JDCLOUD_RE_SS_01
    bool "JDCloud AX1800 Pro (Arthur) board support"
	default n
    help
      Enable support for JDCloud AX1800 Pro (Arthur) board

config TARGET_IPQ6018_LINK_NN6000
    bool "Link NN6000 (V1 & V2) board support"
	default n
    help
      Enable support for Link NN6000 (V1 & V2) board

config TARGET_IPQ6018_OCEANBLUE_S200_H
    bool "OceanBlue Cloud S200-H board support"
	default n
    help
      Enable support for OceanBlue Cloud S200-H board

config TARGET_IPQ6018_PHILIPS_LY1800
    bool "Philips LY1800 board support"
	default n
    help
      Enable support for Philips LY1800 board

config TARGET_IPQ6018_QIHOO_360V6
    bool "Qihoo 360V6 board support"
	default n
    help
      Enable support for Qihoo 360V6 board

config TARGET_IPQ6018_REDMI_AX5
    bool "Redmi AX5 (RA67) board support"
	default n
    help
      Enable support for Redmi AX5 (RA67) board

config TARGET_IPQ6018_REDMI_AX5_JDCLOUD
    bool "Redmi AX5 JDCloud (RA50) board support"
	default n
    help
      Enable support for Redmi AX5 JDCloud (RA50) board

config TARGET_IPQ6018_SY_Y6010
    bool "SY Y6010 board support"
	default n
    help
      Enable support for SY Y6010 board

config TARGET_IPQ6018_XIAOMI_AX1800
    bool "Xiaomi AX1800 (RM1800) board support"
	default n
    help
      Enable support for Xiaomi AX1800 (RM1800) board

config TARGET_IPQ6018_ZN_M2
    bool "ZN M2 board support"
	default n
    help
      Enable support for ZN M2 board

endif # ARCH_IPQ6018
```

## u-boot-2016/board/ipq807x/Kconfig
```kconfig
config SYS_CPU
       default "ipq807x"

config SYS_BOARD
       default "ipq807x"

config SYS_VENDOR
       default "qca/arm"

config SYS_CONFIG_NAME
       default "ipq807x"

config IPQ_I2C
	bool "Enable i2c support on IPQ platform"

config USB_XHCI_IPQ
	bool "ipq807x usb support for ipq807x"

config PCI_IPQ
	bool "ipq807x pci support for ipq807x"

config QCA_AQUANTIA_PHY
	bool "Enable Aquantia PHY support for ipq807x"

config QCA8033_PHY
	bool "Enable QCA8033 PHY support for ipq807x"

config QCA8081_PHY
	bool "Enable QCA8081 PHY support for ipq807x"

config QCA8075_PHY
	bool "Enable QCA8075 PHY support for ipq807x"

config BOARD_TYPES
	bool "Support board_type member in global data"
	default y

config LIST_OF_CONFIG_NAMES_SUPPORT
	bool "List of config names support"

config LIST_FUSE
	bool "Enable fuse list command"
	default n

config TARGET_IPQ807x_ALIYUN_AP8220
    bool "Aliyun AP8220 board support"
	default n
    help
	  Enable support for Aliyun AP8220 board

config TARGET_IPQ807X_CRADLEPOINT_E320
    bool "Cradlepoint E320 board support"
	default n
    help
	  Enable support for Cradlepoint E320 board

config TARGET_IPQ807x_INSEEGO_FG2000
    bool "Inseego FG2000 board support"
	default n
    help
	  Enable support for Inseego FG2000 board

config TARGET_IPQ807X_OPPO_CKB01
    bool "OPPO CKB01 (SoftBank Air 5G) board support"
	default n
    help
	  Enable support for OPPO CKB01 (SoftBank Air 5G) board

config TARGET_IPQ807x_REDMI_AX6
    bool "Redmi AX6 board support"
	default n
    help
	  Enable support for Redmi AX6 board

config TARGET_IPQ807x_XIAOMI_AX3600
    bool "Xiaomi AX3600 board support"
	default n
    help
	  Enable support for Xiaomi AX3600 board
```
